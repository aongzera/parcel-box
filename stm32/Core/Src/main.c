/* USER CODE BEGIN Header */
/**
  ******************************************************************************
  * @file           : main.c
  * @brief          : Smart Parcel Box firmware for the NUCLEO-F411RE: the
  *                   hardware adapter's main loop (product.md section 5,
  *                   ADR 0001).
  *
  * Every BOX_TICK_MS it reads the sensors and feeds them to the Box logic
  * core. The core's Box status changes go through box_lines, which writes
  * the STS lines (and the heartbeat) to the ESP32 and mirrors them to the
  * debug log. The first one also opens the Event sender's session (box_sender
  * sends BOOT until the ESP32 ACKs it). Its Events go to the Event sender,
  * which numbers them and resends each EVT line until the ESP32 ACKs it. Its
  * buzzer commands drive the buzzer pin through board_set_buzzer(). Bytes from the
  * ESP32 arrive by interrupt and are fed to box_rx in the main loop, which
  * mirrors each line to the debug log and hands the ACKs to the sender
  * (all from the main loop, never an interrupt). All the decisions are in
  * BoxCore; this file and the rest of stm32/Core only touch the hardware.
  *
  * Generated by STM32CubeMX from parcel-box.ioc. Keep every hand-written
  * line inside a USER CODE BEGIN/END block, or regenerating deletes it.
  ******************************************************************************
  * @attention
  *
  * Copyright (c) 2026 STMicroelectronics.
  * All rights reserved.
  *
  * This software is licensed under terms that can be found in the LICENSE file
  * in the root directory of this software component.
  * If no LICENSE file comes with this software, it is provided AS-IS.
  *
  ******************************************************************************
  */
/* USER CODE END Header */
/* Includes ------------------------------------------------------------------*/
#include "main.h"

/* Private includes ----------------------------------------------------------*/
/* USER CODE BEGIN Includes */
#include "board.h"
#include "box_core.h"
#include "box_lines.h"
#include "box_rx.h"
#include "box_sender.h"
#include "serial.h"
/* USER CODE END Includes */

/* Private typedef -----------------------------------------------------------*/
/* USER CODE BEGIN PTD */

/* USER CODE END PTD */

/* Private define ------------------------------------------------------------*/
/* USER CODE BEGIN PD */
#define BOX_TICK_MS 10u

/* Debug port only, so the ESP32 never has to parse it. No build timestamp:
 * main.o isn't rebuilt when only other files change, so it would go stale. */
#define BOOT_BANNER "# parcel-box STM32 firmware booted\r\n"
/* USER CODE END PD */

/* Private macro -------------------------------------------------------------*/
/* USER CODE BEGIN PM */

/* USER CODE END PM */

/* Private variables ---------------------------------------------------------*/
UART_HandleTypeDef huart1;
UART_HandleTypeDef huart2;

/* USER CODE BEGIN PV */
static BoxCore core;
static BoxLines lines;
static BoxRx reader;
static BoxSender sender;
/* USER CODE END PV */

/* Private function prototypes -----------------------------------------------*/
void SystemClock_Config(void);
static void MX_GPIO_Init(void);
static void MX_USART1_UART_Init(void);
static void MX_USART2_UART_Init(void);
/* USER CODE BEGIN PFP */

/* USER CODE END PFP */

/* Private user code ---------------------------------------------------------*/
/* USER CODE BEGIN 0 */
static void send_line(void *context, const char *line)
{
  (void)context;
  serial_send_line(line);
}

/* The core's on_buzzer output. Its context is the BoxLines that the other
 * outputs use, so it is ignored here. */
static void drive_buzzer(void *context, bool on, uint32_t now_ms)
{
  (void)context;
  (void)now_ms;
  board_set_buzzer(on);
}

/* box_rx's on_line output: every line the ESP32 sends, unknown ones too. */
static void mirror_received(void *context, const char *line)
{
  (void)context;
  serial_mirror_received(line);
}

/* The core's on_box_status_changed output: the STS line, then (only the
 * first time: the starting state is now known) the sender's BOOT line.
 * Its context is the BoxLines that box_lines_core_outputs() set. */
static void box_status_changed(void *context, BoxStatus status, uint32_t now_ms)
{
  box_lines_on_box_status_changed(context, status, now_ms);
  box_sender_start(&sender, now_ms);
}

/* The core's on_event output: the Event sender numbers it and sends it
 * until it is ACKed. Its context is the BoxLines, so it is ignored here. */
static void event_happened(void *context, BoxEvent event, uint32_t now_ms)
{
  (void)context;
  (void)box_sender_add(&sender, event, now_ms);
}

/* The Event sender's on_dropped output: the outbox was full. */
static void event_dropped(void *context, uint32_t seq, BoxEvent event)
{
  (void)context;
  (void)event;
  serial_debug("# Outbox full: dropped Event ");
  serial_debug_uint(seq);
  serial_debug("\r\n");
}

/* box_rx's on_ack output: `ACK,0` opens the session; `ACK,<seq>` stops the
 * resends of Event `seq`. Only an ACK the sender accepts is logged (the
 * line itself is already mirrored as "< ACK,..."). Called from
 * serial_poll_received(), before the main loop reads its clock for the
 * ticks, so this stamp is never later than theirs. */
static void ack_received(void *context, uint32_t seq)
{
  (void)context;
  if (!box_sender_ack(&sender, seq, HAL_GetTick()))
  {
    return;
  }
  if (seq == BOX_BOOT_SEQ)
  {
    serial_debug("# Session open\r\n");
  }
  else
  {
    serial_debug("# ACK for Event ");
    serial_debug_uint(seq);
    serial_debug("\r\n");
  }
}
/* USER CODE END 0 */

/**
  * @brief  The application entry point.
  * @retval int
  */
int main(void)
{

  /* USER CODE BEGIN 1 */
  BoxLinesOutput output = {0};
  BoxRxOutputs reader_outputs = {0};
  BoxSenderOutputs sender_outputs = {0};
  BoxCoreOutputs core_outputs;
  uint32_t last_tick_ms;
  /* USER CODE END 1 */

  /* MCU Configuration--------------------------------------------------------*/

  /* Reset of all peripherals, Initializes the Flash interface and the Systick. */
  HAL_Init();

  /* USER CODE BEGIN Init */

  /* USER CODE END Init */

  /* Configure the system clock */
  SystemClock_Config();

  /* USER CODE BEGIN SysInit */

  /* USER CODE END SysInit */

  /* Initialize all configured peripherals */
  MX_GPIO_Init();
  MX_USART1_UART_Init();
  MX_USART2_UART_Init();
  /* USER CODE BEGIN 2 */
  serial_debug(BOOT_BANNER);

  output.write_line = send_line;
  box_lines_init(&lines, output);
  sender_outputs.write_line = send_line;
  sender_outputs.on_dropped = event_dropped;
  box_sender_init(&sender, sender_outputs);
  last_tick_ms = HAL_GetTick();
  core_outputs = box_lines_core_outputs(&lines);
  core_outputs.on_box_status_changed = box_status_changed;
  core_outputs.on_event = event_happened;
  core_outputs.on_buzzer = drive_buzzer;
  box_core_init(&core, core_outputs, last_tick_ms, board_read_sensors());

  reader_outputs.on_line = mirror_received;
  reader_outputs.on_ack = ack_received;
  box_rx_init(&reader, reader_outputs);
  serial_start_receiving();
  /* USER CODE END 2 */

  /* Infinite loop */
  /* USER CODE BEGIN WHILE */
  while (1)
  {
    /* USER CODE END WHILE */

    /* USER CODE BEGIN 3 */
    uint32_t now_ms;
    serial_poll_received(&reader);
    /* Read the clock after the ACKs: mirroring them to USART2 takes a few
     * ms, and an ACK stamped later than this pass's ticks would make the
     * Event it sends look overdue. */
    now_ms = HAL_GetTick();
    /* Unsigned subtraction keeps this right when the tick wraps. */
    if ((uint32_t)(now_ms - last_tick_ms) >= BOX_TICK_MS)
    {
      last_tick_ms = now_ms;
      box_core_tick(&core, now_ms, board_read_sensors());
      box_lines_tick(&lines, now_ms);
      box_sender_tick(&sender, now_ms);
    }
  }
  /* USER CODE END 3 */
}

/**
  * @brief System Clock Configuration
  * @retval None
  */
void SystemClock_Config(void)
{
  RCC_OscInitTypeDef RCC_OscInitStruct = {0};
  RCC_ClkInitTypeDef RCC_ClkInitStruct = {0};

  /** Configure the main internal regulator output voltage
  */
  __HAL_RCC_PWR_CLK_ENABLE();
  __HAL_PWR_VOLTAGESCALING_CONFIG(PWR_REGULATOR_VOLTAGE_SCALE1);

  /** Initializes the RCC Oscillators according to the specified parameters
  * in the RCC_OscInitTypeDef structure.
  */
  RCC_OscInitStruct.OscillatorType = RCC_OSCILLATORTYPE_HSI;
  RCC_OscInitStruct.HSIState = RCC_HSI_ON;
  RCC_OscInitStruct.HSICalibrationValue = RCC_HSICALIBRATION_DEFAULT;
  RCC_OscInitStruct.PLL.PLLState = RCC_PLL_ON;
  RCC_OscInitStruct.PLL.PLLSource = RCC_PLLSOURCE_HSI;
  RCC_OscInitStruct.PLL.PLLM = 16;
  RCC_OscInitStruct.PLL.PLLN = 400;
  RCC_OscInitStruct.PLL.PLLP = RCC_PLLP_DIV4;
  RCC_OscInitStruct.PLL.PLLQ = 7;
  if (HAL_RCC_OscConfig(&RCC_OscInitStruct) != HAL_OK)
  {
    Error_Handler();
  }

  /** Initializes the CPU, AHB and APB buses clocks
  */
  RCC_ClkInitStruct.ClockType = RCC_CLOCKTYPE_HCLK|RCC_CLOCKTYPE_SYSCLK
                              |RCC_CLOCKTYPE_PCLK1|RCC_CLOCKTYPE_PCLK2;
  RCC_ClkInitStruct.SYSCLKSource = RCC_SYSCLKSOURCE_PLLCLK;
  RCC_ClkInitStruct.AHBCLKDivider = RCC_SYSCLK_DIV1;
  RCC_ClkInitStruct.APB1CLKDivider = RCC_HCLK_DIV2;
  RCC_ClkInitStruct.APB2CLKDivider = RCC_HCLK_DIV1;

  if (HAL_RCC_ClockConfig(&RCC_ClkInitStruct, FLASH_LATENCY_3) != HAL_OK)
  {
    Error_Handler();
  }
}

/**
  * @brief USART1 Initialization Function
  * @param None
  * @retval None
  */
static void MX_USART1_UART_Init(void)
{

  /* USER CODE BEGIN USART1_Init 0 */

  /* USER CODE END USART1_Init 0 */

  /* USER CODE BEGIN USART1_Init 1 */

  /* USER CODE END USART1_Init 1 */
  huart1.Instance = USART1;
  huart1.Init.BaudRate = 115200;
  huart1.Init.WordLength = UART_WORDLENGTH_8B;
  huart1.Init.StopBits = UART_STOPBITS_1;
  huart1.Init.Parity = UART_PARITY_NONE;
  huart1.Init.Mode = UART_MODE_TX_RX;
  huart1.Init.HwFlowCtl = UART_HWCONTROL_NONE;
  huart1.Init.OverSampling = UART_OVERSAMPLING_16;
  if (HAL_UART_Init(&huart1) != HAL_OK)
  {
    Error_Handler();
  }
  /* USER CODE BEGIN USART1_Init 2 */

  /* USER CODE END USART1_Init 2 */

}

/**
  * @brief USART2 Initialization Function
  * @param None
  * @retval None
  */
static void MX_USART2_UART_Init(void)
{

  /* USER CODE BEGIN USART2_Init 0 */

  /* USER CODE END USART2_Init 0 */

  /* USER CODE BEGIN USART2_Init 1 */

  /* USER CODE END USART2_Init 1 */
  huart2.Instance = USART2;
  huart2.Init.BaudRate = 115200;
  huart2.Init.WordLength = UART_WORDLENGTH_8B;
  huart2.Init.StopBits = UART_STOPBITS_1;
  huart2.Init.Parity = UART_PARITY_NONE;
  huart2.Init.Mode = UART_MODE_TX_RX;
  huart2.Init.HwFlowCtl = UART_HWCONTROL_NONE;
  huart2.Init.OverSampling = UART_OVERSAMPLING_16;
  if (HAL_UART_Init(&huart2) != HAL_OK)
  {
    Error_Handler();
  }
  /* USER CODE BEGIN USART2_Init 2 */

  /* USER CODE END USART2_Init 2 */

}

/**
  * @brief GPIO Initialization Function
  * @param None
  * @retval None
  */
static void MX_GPIO_Init(void)
{
  GPIO_InitTypeDef GPIO_InitStruct = {0};
  /* USER CODE BEGIN MX_GPIO_Init_1 */

  /* USER CODE END MX_GPIO_Init_1 */

  /* GPIO Ports Clock Enable */
  __HAL_RCC_GPIOA_CLK_ENABLE();
  __HAL_RCC_GPIOB_CLK_ENABLE();

  /*Configure GPIO pin Output Level */
  HAL_GPIO_WritePin(BUZZER_GPIO_Port, BUZZER_Pin, GPIO_PIN_RESET);

  /*Configure GPIO pin : BUZZER_Pin */
  GPIO_InitStruct.Pin = BUZZER_Pin;
  GPIO_InitStruct.Mode = GPIO_MODE_OUTPUT_PP;
  GPIO_InitStruct.Pull = GPIO_NOPULL;
  GPIO_InitStruct.Speed = GPIO_SPEED_FREQ_LOW;
  HAL_GPIO_Init(BUZZER_GPIO_Port, &GPIO_InitStruct);

  /*Configure GPIO pins : PARCEL_IR_Pin LID_REED_Pin */
  GPIO_InitStruct.Pin = PARCEL_IR_Pin|LID_REED_Pin;
  GPIO_InitStruct.Mode = GPIO_MODE_INPUT;
  GPIO_InitStruct.Pull = GPIO_PULLUP;
  HAL_GPIO_Init(GPIOB, &GPIO_InitStruct);

  /* USER CODE BEGIN MX_GPIO_Init_2 */

  /* USER CODE END MX_GPIO_Init_2 */
}

/* USER CODE BEGIN 4 */

/* USER CODE END 4 */

/**
  * @brief  This function is executed in case of error occurrence.
  * @retval None
  */
void Error_Handler(void)
{
  /* USER CODE BEGIN Error_Handler_Debug */
  /* User can add his own implementation to report the HAL error return state */
  __disable_irq();
  while (1)
  {
  }
  /* USER CODE END Error_Handler_Debug */
}
#ifdef USE_FULL_ASSERT
/**
  * @brief  Reports the name of the source file and the source line number
  *         where the assert_param error has occurred.
  * @param  file: pointer to the source file name
  * @param  line: assert_param error line source number
  * @retval None
  */
void assert_failed(uint8_t *file, uint32_t line)
{
  /* USER CODE BEGIN 6 */
  /* User can add his own implementation to report the file name and line number,
     ex: printf("Wrong parameters value: file %s on line %d\r\n", file, line) */
  /* USER CODE END 6 */
}
#endif /* USE_FULL_ASSERT */
